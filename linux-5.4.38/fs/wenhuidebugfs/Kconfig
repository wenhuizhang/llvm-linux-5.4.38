## linux-5.4.38/fs/wenhuidebugfs/Kconfig
```kconfig
# SPDX-License-Identifier: GPL-2.0-only
config WENHUI_DEBUG
        bool "DEBUG WENHUI support"
        help
          debug filesystem for printing redundancy graph
```
